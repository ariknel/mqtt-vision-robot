/*
 * oled.c — SSD1306 128x32 driver over ESP-IDF I2C.
 *
 * No external library. Raw I2C + built-in 5x7 font (public domain,
 * derived from Adafruit glcdfont.c). Each character is 6 pixels wide
 * (5 glyph + 1 spacing) × 8 pixels tall (one SSD1306 page).
 * Fits 21 chars per line, 4 lines total — we use lines 0-2.
 */
#include "oled.h"
#include "config.h"
#include <string.h>
#include <stdio.h>

#include "driver/i2c_master.h"
#include "esp_log.h"

static const char *TAG = "OLED";

#define I2C_TIMEOUT_MS  10

static i2c_master_dev_handle_t s_dev;

/* ── 5×7 font, printable ASCII 0x20–0x7E (95 chars × 5 bytes) ────────── */
/* Each byte = one column of 7 pixels, bit-0 = top row.                   */
static const uint8_t FONT[95][5] = {
    {0x00,0x00,0x00,0x00,0x00}, /* 0x20   */
    {0x00,0x00,0x5F,0x00,0x00}, /* 0x21 ! */
    {0x00,0x07,0x00,0x07,0x00}, /* 0x22 " */
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    {0x10,0x08,0x08,0x10,0x08}, /* 0x7E ~ */
};

/* ── Low-level I2C helpers ────────────────────────────────────────────── */
static void i2c_cmd(uint8_t cmd)
{
    uint8_t buf[2] = { 0x00, cmd };   /* 0x00 = command stream */
    i2c_master_transmit(s_dev, buf, 2, I2C_TIMEOUT_MS);
}

/* Write up to 32 data bytes in one transaction (0x40 = data stream). */
static void i2c_data(const uint8_t *d, size_t len)
{
    uint8_t buf[33];                  /* 1 control + 32 data max */
    if (len > 32) len = 32;
    buf[0] = 0x40;
    memcpy(buf + 1, d, len);
    i2c_master_transmit(s_dev, buf, len + 1, I2C_TIMEOUT_MS);
}

/* ── SSD1306 init sequence for 128×32 ────────────────────────────────── */
static const uint8_t INIT_SEQ[] = {
    0xAE,        /* display off */
    0xD5, 0x80,  /* clock divider */
    0xA8, 0x1F,  /* multiplex ratio: 32 rows */
    0xD3, 0x00,  /* display offset: 0 */
    0x40,        /* start line: 0 */
    0x8D, 0x14,  /* charge pump on */
    0x20, 0x00,  /* horizontal addressing mode */
    0xA1,        /* segment remap */
    0xC8,        /* COM scan direction */
    0xDA, 0x02,  /* COM pins: 128×32 */
    0x81, 0xCF,  /* contrast */
    0xD9, 0xF1,  /* pre-charge */
    0xDB, 0x40,  /* VCOMH */
    0xA4,        /* resume from RAM */
    0xA6,        /* normal (non-inverted) */
    0xAF,        /* display on */
};

/* Set cursor to page (0-3) and column 0, ready for horizontal streaming. */
static void set_cursor(uint8_t page)
{
    i2c_cmd(0xB0 | (page & 0x03)); /* page address */
    i2c_cmd(0x00);                  /* column low nibble = 0 */
    i2c_cmd(0x10);                  /* column high nibble = 0 */
}

/* Print string at page, clears to end of line with spaces. */
static void print_line(uint8_t page, const char *str)
{
    set_cursor(page);
    int col = 0;
    while (*str && col < 21) {        /* 128px / 6px per char = 21 chars max */
        uint8_t ch = (uint8_t)*str++;
        if (ch < 0x20 || ch > 0x7E) ch = 0x20;
        uint8_t glyph[6];
        memcpy(glyph, FONT[ch - 0x20], 5);
        glyph[5] = 0x00;              /* 1-pixel gap */
        i2c_data(glyph, 6);
        col++;
    }
    /* Pad remaining columns with blank */
    uint8_t blank[6] = {0};
    while (col++ < 21) i2c_data(blank, 6);
}

/* ── Public API ───────────────────────────────────────────────────────── */
void oled_init(void)
{
    i2c_master_bus_config_t bus_cfg = {
        .i2c_port            = I2C_NUM_0,
        .sda_io_num          = PIN_OLED_SDA,
        .scl_io_num          = PIN_OLED_SCL,
        .clk_source          = I2C_CLK_SRC_DEFAULT,
        .glitch_ignore_cnt   = 7,
        .flags.enable_internal_pullup = true,
    };
    i2c_master_bus_handle_t bus;
    ESP_ERROR_CHECK(i2c_new_master_bus(&bus_cfg, &bus));

    i2c_device_config_t dev_cfg = {
        .dev_addr_length = I2C_ADDR_BIT_LEN_7,
        .device_address  = OLED_ADDRESS,
        .scl_speed_hz    = 400000,
    };
    ESP_ERROR_CHECK(i2c_master_bus_add_device(bus, &dev_cfg, &s_dev));

    for (size_t i = 0; i < sizeof(INIT_SEQ); i++) i2c_cmd(INIT_SEQ[i]);

    /* Clear all 4 pages */
    for (int p = 0; p < 4; p++) print_line(p, "");
    ESP_LOGI(TAG, "OLED ready");
}

void oled_update(float battery, bool mqtt_ok, RobotMode mode, RobotState state)
{
    char buf[24];

    /* Line 0 — battery */
    snprintf(buf, sizeof(buf), "BAT: %.2fV", battery);
    print_line(0, buf);

    /* Line 1 — MQTT */
    snprintf(buf, sizeof(buf), "MQTT: %s", mqtt_ok ? "OK" : "--");
    print_line(1, buf);

    /* Line 2 — mode / state */
    if (mode == MODE_MANUAL) {
        snprintf(buf, sizeof(buf), "MANUAL");
    } else {
        const char *st = "?";
        switch (state) {
            case STATE_FOLLOWING:  st = "FOLLOWING";  break;
            case STATE_AVOIDING:   st = "AVOIDING";   break;
            case STATE_RECOVERING: st = "RECOVERING"; break;
            default:               st = "LINE";       break;
        }
        snprintf(buf, sizeof(buf), "%s", st);
    }
    print_line(2, buf);
}
